#include <Servo.h>                   // Подключение библиотеки для работы с сервоприводом

Servo myservo;                       // Создание объекта сервопривода
int pos = 0;                         // Переменная для хранения текущей позиции сервопривода
int state;                           // Переменная для хранения состояния (полученного через Serial)
int flag = 0;                        // Флаг для отслеживания состояния

void setup() {
  myservo.attach(9);                 // Подключение сервопривода к пину 9
  Serial.begin(9600);                // Установка порта для обмена информацией с компьютером
  myservo.write(60);                 // Установка начальной позиции сервопривода в 60 градусов
  delay(1000);                       // Задержка в 1 секунду, чтобы сервопривод успел принять положение
}

void loop() {
  if (Serial.available() > 0) {      // Проверка, если в последовательном порте есть какие-либо данные
    state = Serial.read();           // Чтение значений из последовательного порта
    flag = 0;                        // Сброс флага
  }

  if (state == '0') {                // Если полученное состояние равно '0'
    myservo.write(8);                // Устанавливаем сервопривод в положение 8 градусов
    delay(1000);                     // Задержка в 1 секунду
    Serial.println("Door Locked");   // Вывод сообщения в серийный порт о блокировке двери
  } else if (state == '1') {         // Если полученное состояние равно '1'
    myservo.write(55);               // Устанавливаем сервопривод в положение 55 градусов
    delay(1000);                     // Задержка в 1 секунду
    Serial.println("Door UnLocked"); // Вывод сообщения в серийный порт об открытии двери
  }
}
